## lander/sdkconfig.defaults
```kconfig
# Project defaults. sdkconfig itself is gitignored/regenerated, so persistent
# configuration belongs here.

# Target chip
CONFIG_IDF_TARGET="esp32"

# Use the custom partition table (2 MB app). The ESP-IDF v6 image is larger
# than v5 and overflows the default single-app (~1 MB) partition.
CONFIG_PARTITION_TABLE_CUSTOM=y
CONFIG_PARTITION_TABLE_CUSTOM_FILENAME="partitions.csv"
CONFIG_ESP32_BNO08X_GPIO_SCL=5
CONFIG_ESP32_BNO08X_GPIO_DI=19
CONFIG_ESP32_BNO08X_GPIO_SDA=21
CONFIG_ESP32_BNO08X_GPIO_CS=13
```
